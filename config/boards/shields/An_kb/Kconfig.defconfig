## config/boards/shields/An_kb/Kconfig.defconfig
```kconfig
if SHIELD_AN_KB_LEFT

config ZMK_KEYBOARD_NAME
    default "An KB"

config ZMK_SPLIT_ROLE_CENTRAL
    default y

endif

if SHIELD_AN_KB_LEFT || SHIELD_AN_KB_RIGHT

config ZMK_SPLIT
    default y

endif
```

## config/boards/shields/An_kb/Kconfig.shield
```kconfig
config SHIELD_AN_KB_LEFT
    def_bool $(shields_list_contains,An_kb_left)

config SHIELD_AN_KB_RIGHT
    def_bool $(shields_list_contains,An_kb_right)
```
